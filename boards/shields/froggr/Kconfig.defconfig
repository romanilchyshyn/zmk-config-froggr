## boards/shields/froggr/Kconfig.defconfig
```kconfig
if SHIELD_FROGGR

config ZMK_KEYBOARD_NAME
    default "froggr"

endif # SHIELD_FROGGR
```

## config/west.yml
```yaml
manifest:
  defaults:
    # Pinned to a specific ZMK commit (no release tag has Studio yet; main floats).
    # ff09f2d0 = ZMK main @ 2026-06-07 — the tree this config was verified against.
    revision: ff09f2d0c9f13a868c8f71d71d9348ade438e4b6
  remotes:
    - name: zmkfirmware
      url-base: https://github.com/zmkfirmware
    # Additional modules containing boards/shields/custom code can be listed here as well
    # See https://docs.zephyrproject.org/3.2.0/develop/west/manifest.html#projects
  projects:
    - name: zmk
      remote: zmkfirmware
      import: app/west.yml
  self:
    path: config
```

## dts/bindings/gpio/nxp,pca9555.yaml
```yaml
description: NXP PCA9555 I2C I/O expander

compatible: "nxp,pca9555"

include:
  - name: base.yaml
  - name: gpio-controller.yaml

properties:
  reg:
    required: true
  ngpios:
    type: int
    required: false
    default: 16
    description: Number of gpios supported
  interrupt-gpios:
    type: phandle-array
    required: false
    description: Interrupt GPIO pin connected to the INT line

gpio-cells:
  - pin
  - flags
```

## dts/bindings/gpio/nxp,pca95xx.yaml
```yaml
description: NXP PCA95XX I2C I/O expander

compatible: "nxp,pca95xx"

include:
  - name: base.yaml
  - name: gpio-controller.yaml

properties:
  reg:
    required: true
  interrupt-gpios:
    type: phandle-array
    required: false
    description: Interrupt GPIO pin connected to the INT line

gpio-cells:
  - pin
  - flags
```
